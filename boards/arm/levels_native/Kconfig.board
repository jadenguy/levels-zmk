## boards/arm/levels_native/Kconfig.board
```kconfig
# SPDX-License-Identifier: MIT

config BOARD_LEVELS_NATIVE
  bool "levels_native"
  depends on SOC_NRF52840_QIAA
```

## boards/arm/levels_native/Kconfig.defconfig
```kconfig
# SPDX-License-Identifier: MIT

if BOARD_LEVELS_NATIVE

config BOARD
  default "levels_native"

if USB_DEVICE_STACK

config USB_NRFX
  default y

endif #USB

config BT_CTLR
  default BT

endif # BOARD_LEVELS_NATIVE
```

## boards/shields/levels/Kconfig.defconfig
```kconfig
if SHIELD_LEVELS_LEFT

config ZMK_KEYBOARD_NAME
  default "Levels 54-R2"

config ZMK_SPLIT_ROLE_CENTRAL
  default y

endif

if SHIELD_LEVELS_LEFT || SHIELD_LEVELS_RIGHT

config ZMK_SPLIT
  default y


endif
```

## boards/shields/levels/Kconfig.shield
```kconfig
config SHIELD_LEVELS_LEFT
  def_bool $(shields_list_contains,levels_left)

config SHIELD_LEVELS_RIGHT
  def_bool $(shields_list_contains,levels_right)
```
