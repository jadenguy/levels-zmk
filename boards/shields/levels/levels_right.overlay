#include "levels.dtsi"

&default_transform {
  col-offset = <6>;
};

&kscan0 {
  compatible = "zmk,kscan-gpio-matrix";
  diode-direction = "col2row";
  wakeup-source;

  col-gpios
    = <&pro_micro 15 GPIO_ACTIVE_HIGH>
    , <&pro_micro 9 GPIO_ACTIVE_HIGH>
    , <&pro_micro 10 GPIO_ACTIVE_HIGH>
    , <&pro_micro 19 GPIO_ACTIVE_HIGH>
    , <&pro_micro 20 GPIO_ACTIVE_HIGH>
    , <&pro_micro 16 GPIO_ACTIVE_HIGH>
    ;
};
